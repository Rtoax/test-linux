// SPDX-License-Identifier: GPL-2.0+ OR MIT
/*
 * Empty device tree for qemu_arm64-custom
 *
 * Copyright 2023-2025 Rong Tao
 *
 * 2023-09-08	Rong Tao	Create this.
 */

/dts-v1/;

/ {
	model = "MyEdge 250";
	compatible = "friendlyelec,nanopc-t4";
};
